## drivers/input/misc/lsm6ds3/Kconfig
```kconfig
config INPUT_LSM6DS3
         tristate "STMicroelectronics LSM6DS3 sensor"
         depends on (I2C || SPI_MASTER) && SYSFS
		 select INPUT_LSM6DS3_I2C if I2C
		 select INPUT_LSM6DS3_SPI if SPI
         help
           This driver support the STMicroelectronics LSM6DS3 sensor.

           To compile this driver as a module, choose M here. The module
	   will be called lsm6ds3.

config INPUT_LSM6DS3_I2C
	tristate

config INPUT_LSM6DS3_SPI
	tristate
```
